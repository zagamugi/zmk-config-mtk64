## config/boards/shields/mtk64/Kconfig.shield
```kconfig
config SHIELD_MTK64_R
    def_bool $(shields_list_contains,mtk64_R)

config SHIELD_MTK64_L
    def_bool $(shields_list_contains,mtk64_L)

config SHIELD_MTK64_DONGLE
    def_bool $(shields_list_contains,mtk64_DONGLE)

config MTK64_DONGLE_STATUS_LED
    bool "Enable status LED support for mtk64 dongle"
    default n
    depends on SHIELD_MTK64_DONGLE
```

## config/west.yml
```yaml
manifest:
  remotes:
    - name: zmkfirmware
      url-base: https://github.com/zmkfirmware
    - name: mentako-ya
      url-base: https://github.com/mentako-ya
    - name: badjeff
      url-base: https://github.com/badjeff
    - name: caksoylar
      url-base: https://github.com/caksoylar
    - name: zagamugi
      url-base: https://github.com/zagamugi
  projects:
    - name: zmk
      remote: zmkfirmware
      revision: main
      import: app/west.yml
    - name: zmk-pmw3610-driver
      remote: badjeff
      revision: main
    - name: zmk-rgbled-widget
      remote: caksoylar
      revision: main
    - name: zmk-dongle-display
      remote: zagamugi
      revision: mentako_zephyr-4.1
  self:
    path: config
```
