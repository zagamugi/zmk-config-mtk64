#include "mtk64.dtsi"
#include "mtk64_trackball.dtsi"

&default_transform {
    row-offset = <14>;
};

&xiao_serial { status = "disabled"; };

/* central(FOOT) 側で listener を有効化 */
&trackball_listener {
    status = "okay";
};
